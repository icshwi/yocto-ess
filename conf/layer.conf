## conf/layer.conf
```bitbake
# We have a conf and classes directory, add to BBPATH
BBPATH .= ":${LAYERDIR}"

# We have recipes-* directories, add to BBFILES
BBFILES += "${LAYERDIR}/recipes-*/*/*.bb \
	${LAYERDIR}/recipes-*/*/*.bbappend"

BBFILE_COLLECTIONS += "ifc1410"
BBFILE_PATTERN_ifc1410 = "^${LAYERDIR}/"
BBFILE_PRIORITY_ifc1410 = "6"

LAYERSERIES_COMPAT_ifc1410 = "sumo"
```

## conf/machine/ifc1410-64b.conf
```bitbake
#@TYPE: Machine
#@NAME: NXP T2080RDB
#@SOC: t2080
#@DESCRIPTION: Machine configuration for NXP QorIQ T2080 Reference
#              Design Board with ppce6500 core in 32b mode
#@MAINTAINER: Chunrong Guo <chunrong.guo@nxp.com>

require conf/machine/include/e6500-64b.inc

SOC_FAMILY = "t2:t2080"

UBOOT_CONFIG ??= "nor"
UBOOT_CONFIG[nor] = "IFC1410_defconfig"

HV_CFG_M = "t2080rdb"

KERNEL_DEVICETREE ?= "fsl/ifc1410-sdk.dtb"
KERNEL_DEFCONFIG ?= "ifc1410_defconfig"

JFFS2_ERASEBLOCK = "0x10000"

EXTRA_IMAGEDEPENDS += "fm-ucode rcw"

USE_VT ?= "0"

IMAGE_INSTALL_append = " kernel-image kernel-devicetree nfs-utils readline \
                         boost curl libxml2 zlib libpng nano tree perl \
                         perl-module-posix kernel-module-tsc"
IMAGE_INSTALL_remove = " udev-rules-qoriq"
```

## recipes-bsp/u-boot/u-boot-qoriq-2017.12/IFC1410_defconfig
```kconfig
CONFIG_PPC=y
CONFIG_MPC85xx=y
CONFIG_TARGET_IFC1410=y
# looks like the CONFIG_SYS_EXTRA_OPTIONS="PPC_T2080" is not used anymore
# CONFIG_SYS_EXTRA_OPTIONS="PPC_T2080"
# not available in IOxOS original
CONFIG_FIT=y
CONFIG_FIT_VERBOSE=y
CONFIG_OF_BOARD_SETUP=y
CONFIG_OF_STDOUT_VIA_ALIAS=y
CONFIG_BOOTDELAY=10
CONFIG_HUSH_PARSER=y
CONFIG_CMD_IMLS=y
CONFIG_CMD_MEMTEST=y
CONFIG_CMD_MMC=y
CONFIG_CMD_SF=y
CONFIG_CMD_I2C=y
# CONFIG_CMD_USB is not set
CONFIG_CMD_DHCP=y
CONFIG_CMD_MII=y
CONFIG_CMD_PING=y
CONFIG_CMD_EXT2=y
CONFIG_CMD_FAT=y
CONFIG_CMD_MTDPARTS=y
CONFIG_MTDIDS_DEFAULT="nor0=fe8000000.nor,nand0=fff800000.flash, spi0=spife110000.1"
CONFIG_MTDPARTS_DEFAULT="mtdparts=fe8000000.nor:1m(uboot),5m(kernel), 128k(dtb),96m(fs),-(user);fff800000.flash:1m(uboot), 5m(kernel),128k(dtb),96m(fs),-(user);spife110000.1: 1m(uboot),5m(kernel),128k(dtb),-(user)"
# CONFIG_CMD_IRQ is not set
CONFIG_FSL_CAAM=y
CONFIG_MTD_NOR_FLASH=y
CONFIG_SPI_FLASH=y
CONFIG_SPI_FLASH_STMICRO=y
CONFIG_PHYLIB=y
CONFIG_NETDEVICES=y
CONFIG_PHY_GIGE=y
CONFIG_E1000=y
CONFIG_SYS_NS16550=y
CONFIG_FSL_ESPI=y
# not available in IOxOS original
# CONFIG_USB is not set
# CONFIG_USB_STORAGE  is not set
CONFIG_OF_LIBFDT=y
CONFIG_PHY_MICREL=y
CONFIG_PHY_MICREL_KSZ90X1=y
CONFIG_ENV_IS_IN_FLASH=y
CONFIG_SYS_DPAA_QBMAN=y
CONFIG_CMD_REGINFO=y
CONFIG_CMD_PCI=y
CONFIG_CMD_NAND=y
```

## recipes-bsp/u-boot/u-boot-qoriq-2017.12/ifc1410/Kconfig
```kconfig
if TARGET_IFC1410

config SYS_BOARD
	default "ifc1410"

config SYS_VENDOR
	default "freescale"

config SYS_CONFIG_NAME
	default "ifc1410"

endif
```

## sources/meta-ess/conf/distro/cct.conf
```bitbake
require conf/distro/poky.conf

DISTRO = "cct"
DISTRO_NAME = "Concurrent CPU SDK"
DISTRO_FEATURES_append = " pam systemd virtulization"

SDK_VERSION = "${@'${DISTRO_VERSION}'.replace('snapshot-${DATE}','snapshot')}-4.14"

PACKAGECONFIG_append_pn-systemd = " resolved networkd hostnamed polkit"
```

## sources/meta-ess/conf/distro/fpgaioc.conf
```bitbake
require conf/distro/poky.conf

DISTRO = "fpgaioc"
DISTRO_NAME = "FPGA-IOC SDK"
DISTRO_FEATURES += "polkit"

SDK_VERSION = "${@'${DISTRO_VERSION}'.replace('snapshot-${DATE}','snapshot')}-5.4"

# Change SDK name
SDK_VERSION = "xilinx-standalone"

BBMASK += "/meta-xilinx-bsp/recipes-bsp/uboot-device-tree"
```

## sources/meta-ess/conf/distro/ifc14xx.conf
```bitbake
require conf/distro/poky.conf

DISTRO = "ifc14xx"
DISTRO_NAME = "IFC14XX QorIQ SDK"
MAINTAINER = "Freescale Yocto Team <meta-freescale@yoctoproject.org>"

TARGET_VENDOR = "-fsl"

SDK_VENDOR = "-fslsdk"
SDK_NAME_PREFIX = "${DISTRO}"
SDK_VERSION = "${@'${DISTRO_VERSION}'.replace('snapshot-${DATE}','snapshot')}-${PREFERRED_VERSION_linux-qoriq_qoriq-ppc}"

POKY_DEFAULT_DISTRO_FEATURES_remove = " ptest"
DISTRO_FEATURES_append = " opengl pam virtualization"
DISTRO_FEATURES_remove = " gobject-introspection-data"

LICENSE_FLAGS_WHITELIST = "non-commercial_netperf"

MKUBIFS_ARGS = "-m 512 -e 15360 -c 12000"
UBINIZE_ARGS = "-m 512 -p 16KiB -s 512"

BOOT_TYPE ?= "nor"
BOOT_TYPE_ls1043a = "sd"
BOOT_TYPE_ls1046a = "sd"
BOOT_TYPE_ls1088a = "qspi"
BOOT_TYPE_ls2088a = "qspi"

PREFERRED_PROVIDER_qemu_qoriq = "qemu-qoriq"

PREFERRED_VERSION_linux-qoriq_qoriq-ppc = "4.14"
PREFERRED_VERSION_virtual/nativesdk-libiconv = "2.20"
TARGET_CC_KERNEL_ARCH_e6500 = " -m64"
TARGET_LD_KERNEL_ARCH_e6500 = " -melf64ppc"

GIO_MODULE_PACKAGES = ""
```

## sources/meta-ess/conf/layer.conf
```bitbake
# We have a conf and classes directory, add to BBPATH
BBPATH .= ":${LAYERDIR}"

# We have recipes-* directories, add to BBFILES
BBFILES += "${LAYERDIR}/recipes-*/*/*.bb \
	${LAYERDIR}/recipes-*/*/*.bbappend"

BBFILE_COLLECTIONS += "ess"
BBFILE_PATTERN_ess = "^${LAYERDIR}/"
BBFILE_PRIORITY_ess = "6"

LAYERSERIES_COMPAT_ess = "sumo thud gatesgarth"

LICENSE_PATH += "${LAYERDIR}/custom-licenses"
```

## sources/meta-ess/conf/machine/cct-64.conf
```bitbake
#@TYPE: Machine
#@NAME: intel-corei7-64

#@DESCRIPTION: Machine configuration for 64 bit Intel Core i7 CPU (and later) with MMX, SSE, SSE2, SSE3, and SSSE3 instruction set support. Supports a moderately wide range of drivers that should boot and be usable on "typical" hardware.

require conf/machine/include/meta-intel.inc
require conf/machine/include/intel-corei7-64-common.inc
require conf/machine/include/intel-common-pkgarch.inc

MACHINE_FEATURES += "pcbios efi"
MACHINE_FEATURES += "wifi 3g nfc"
MACHINE_FEATURES += "intel-ucode"

MACHINE_HWCODECS ?= "intel-vaapi-driver gstreamer1.0-vaapi"

# Enable optional dpdk:
COMPATIBLE_MACHINE_pn-dpdk = "intel-corei7-64"
COMPATIBLE_MACHINE_pn-dpdk-dev-libibverbs = "intel-corei7-64"

# Enable optional QAT items:
COMPATIBLE_MACHINE_pn-qat16 = "intel-corei7-64"
COMPATIBLE_MACHINE_pn-qat17 = "intel-corei7-64"
COMPATIBLE_MACHINE_pn-zlib-qat = "intel-corei7-64"

XSERVER ?= "${XSERVER_X86_BASE} \
            ${XSERVER_X86_EXT} \
            ${XSERVER_X86_FBDEV} \
            ${XSERVER_X86_I915} \
            ${XSERVER_X86_I965} \
            ${XSERVER_X86_MODESETTING} \
            ${XSERVER_X86_VESA} \
            ${XSERVER_X86_ASPEED_AST} \
           "

SYSLINUX_OPTS = "serial 0 115200"
SERIAL_CONSOLES = "115200;ttyS0 115200;ttyS1 115200;ttyS2"
APPEND += "ip=:172.30.4.170:::::off console=ttyS0,115200 console=tty0 pci=realloc pciehp.pciehp_force=1 pcie_ports=native"

IMAGE_FSTYPES += "wic"
WKS_FILE ?= "${@bb.utils.contains_any("EFI_PROVIDER", "systemd-boot", "systemd-bootdisk-microcode.wks", "grub-bootdisk-microcode.wks", d)}"
WKS_FILE_DEPENDS_append = " intel-microcode"

IMAGE_INSTALL_append = " sudo \
                         polkit \
                         eth-config \
                         nfs-utils \
                         readline \
                         boost \
                         curl \
                         libxml2 \
                         zlib \
                         libpng \
                         nano \
                         tree \
                         perl \
                         perl-module-posix \
                         kernel-module-tsc \
                         tscmon \
                         coreutils \
                         sysfsutils \
                         sysklogd \
                         libhugetlbfs \
                         kmod \
                         kernel-modules \
                         sysstat \
                         pciutils \
                         screen \
                         procserv \
                         libtirpc \
                         dhcp-client \
                         cct-dhcp-conf \
                         dnf \
                         host-setup \
                         jpeg \
                         cct-conf \
                         mrfioc2 \
                         python3-pkgutil \
                         "

LINUX_VERSION_EXTENSION = "-cct"
```

## sources/meta-ess/conf/machine/cct-rt-64.conf
```bitbake
require conf/machine/cct-64.conf

PREFERRED_PROVIDER_virtual/kernel = "linux-intel-rt"
```

## sources/meta-ess/conf/machine/fpgaioc.conf
```bitbake
#@TYPE: Machine
#@NAME: fpga-ioc

#@DESCRIPTION: Machine configuration for FPGAIOC (PicoZed 7030 SOM).

require conf/machine/include/tune-zynq.inc
require conf/machine/include/machine-xilinx-overrides.inc
require conf/machine/include/machine-xilinx-default.inc

MACHINE ?= "picozed-zynq7"
MACHINE_FEATURES = "ext2 vfat usbhost usbgadget"

SYSLINUX_OPTS = "serial 0 115200"
SERIAL_CONSOLE = "115200 ttyPS0"
APPEND += "ip=:172.30.4.170:::::off console=ttyPS0,115200"

# u-boot configuration
PREFERRED_PROVIDER_virtual/bootloader = "u-boot"
UBOOT_MACHINE = "zynq_picozed_config"
SPL_BINARY ?= "spl/boot.bin"
UBOOT_ELF_zynq = "u-boot"

EXTRA_IMAGEDEPENDS += " \
                        u-boot-zynq-uenv \
                        virtual/boot-bin \
                        virtual/bootloader \
                        "

MACHINE_ESSENTIAL_EXTRA_RDEPENDS += "device-tree"

IMAGE_BOOT_FILES += " \
                     boot.bin \
                     uEnv.txt \
                     "

IMAGE_INSTALL_append += " sudo \
                          openssh-sftp-server \ 
                          e2fsprogs-e2fsck e2fsprogs-mke2fs e2fsprogs-tune2fs e2fsprogs-badblocks e2fsprogs-resize2fs \
                          coreutils \
                          dosfstools \
                          i2c-tools \
                          dhcp-client \  
                          fpgaioc-dhcp-conf \
                          "

LINUX_VERSION_EXTENSION = "-fpgaioc"

## Initramfs Options 
INITRAMFS_IMAGE = "fpgaioc-image"
INITRAMFS_MAXSIZE = "44805176"
```

## sources/meta-ess/conf/machine/ifc14xx-64b.conf
```bitbake
#@TYPE: Machine
#@NAME: NXP T2080RDB
#@SOC: t2080
#@DESCRIPTION: Machine configuration for NXP QorIQ T2080 Reference
#              Design Board with ppce6500 core in 32b mode
#@MAINTAINER: Chunrong Guo <chunrong.guo@nxp.com>

require conf/machine/include/e6500-64b.inc

SOC_FAMILY = "t2:t2080"

UBOOT_CONFIG ??= "nor"
UBOOT_CONFIG[nor] = "IFC14XX_defconfig"

HV_CFG_M = "t2080rdb"

KERNEL_DEVICETREE ?= "fsl/ifc14xx-sdk.dtb"
KERNEL_DEFCONFIG ?= "ifc14xx_defconfig"

JFFS2_ERASEBLOCK = "0x10000"

EXTRA_IMAGEDEPENDS += "fm-ucode rcw"

USE_VT ?= "0"

IMAGE_INSTALL_append = " i2c-tools eth-config fmc nfs-utils readline \
                         boost curl libxml2 zlib libpng nano tree perl \
                         perl-module-posix kernel-module-tsc tscmon \
                         coreutils sysfsutils sysklogd libhugetlbfs \
                         kmod kernel-modules sysstat pciutils screen \
                         ifc14xx-conf procserv libtirpc sudo dnf \
                         host-setup jpeg i2c-udev-rules"
IMAGE_INSTALL_remove = " udev-rules-qoriq"
BBMASK = " lxc"

SERIAL_CONSOLES = "115200;ttyS0 115200;ttyS1"

# Initramfs Options
INITRAMFS_IMAGE = "ifc14xx-image"
INITRAMFS_IMAGE_BUNDLE = "1"
INITRAMFS_MAXSIZE = "524288"
```

## sources/meta-ess/conf/machine/ifc14xx-rt-64b.conf
```bitbake
require conf/machine/ifc14xx-64b.conf

KERNEL_DEFCONFIG = "ifc14xx_rt_defconfig"
PREFERRED_PROVIDER_virtual/kernel = "linux-qoriq-rt"
```

## sources/meta-ess/recipes-bsp/u-boot/u-boot-qoriq-2019.10/IFC14XX_defconfig
```kconfig
CONFIG_PPC=y
CONFIG_SYS_TEXT_BASE=0xEFF40000
CONFIG_MPC85xx=y
CONFIG_TARGET_IFC14XX=y
CONFIG_MPC85XX_HAVE_RESET_VECTOR=y
# looks like the CONFIG_SYS_EXTRA_OPTIONS="PPC_T2080" is not used anymore
# CONFIG_SYS_EXTRA_OPTIONS="PPC_T2080"
# not available in IOxOS original
CONFIG_FIT=y
CONFIG_FIT_VERBOSE=y
CONFIG_OF_BOARD_SETUP=y
CONFIG_OF_STDOUT_VIA_ALIAS=y
CONFIG_BOOTDELAY=10
CONFIG_BOARD_EARLY_INIT_R=y
CONFIG_HUSH_PARSER=y
CONFIG_CMD_IMLS=y
CONFIG_CMD_GREPENV=y
CONFIG_CMD_MEMTEST=y
CONFIG_CMD_MMC=y
CONFIG_CMD_SF=y
CONFIG_CMD_I2C=y
# CONFIG_CMD_USB is not set
CONFIG_CMD_DHCP=y
CONFIG_CMD_MII=y
CONFIG_CMD_PING=y
CONFIG_MP=y
CONFIG_CMD_EXT2=y
CONFIG_CMD_FAT=y
CONFIG_CMD_MTDPARTS=y
CONFIG_MTDIDS_DEFAULT="nor1=spi32766.0"
CONFIG_MTDPARTS_DEFAULT="mtdparts=spi32766.0:50m(kernel),1m(dtb),-(free)"
# CONFIG_OF_CONTROL=y
# CONFIG_OF_EMBED=y
# CONFIG_DEFAULT_DEVICE_TREE="ifc14xx"
# CONFIG_CMD_IRQ is not set
CONFIG_FSL_CAAM=y
CONFIG_MTD_NOR_FLASH=y
CONFIG_SPI_FLASH=y
CONFIG_SF_DEFAULT_MODE=0
CONFIG_SF_DEFAULT_SPEED=10000000
CONFIG_SPI_FLASH_EON=y
CONFIG_SPI_FLASH_STMICRO=y
CONFIG_SPI_FLASH_MTD=y
CONFIG_PHYLIB=y
CONFIG_NETDEVICES=y
CONFIG_PHY_GIGE=y
CONFIG_E1000=y
CONFIG_FMAN_ENET=y
CONFIG_MII=y
CONFIG_DM_PCI=y
CONFIG_DM_PCI_COMPAT=y
CONFIG_PCIE_FSL=y
CONFIG_SYS_QE_FMAN_FW_IN_NOR=y
CONFIG_SYS_NS16550=y
CONFIG_FSL_ESPI=y
# not available in IOxOS original
# CONFIG_USB is not set
# CONFIG_USB_STORAGE  is not set
CONFIG_OF_LIBFDT=y
CONFIG_PHY_MICREL=y
CONFIG_PHY_MICREL_KSZ90X1=y
CONFIG_ENV_IS_IN_FLASH=y
CONFIG_SYS_DPAA_QBMAN=y
CONFIG_CMD_REGINFO=y
CONFIG_CMD_PCI=y
CONFIG_CMD_NAND=y
```

## sources/meta-ioxos/conf/distro/ifc14xx.conf
```bitbake
require conf/distro/poky.conf

DISTRO = "ifc14xx"
DISTRO_NAME = "IFC14XX QorIQ SDK"
MAINTAINER = "Freescale Yocto Team <meta-freescale@yoctoproject.org>"

TARGET_VENDOR = "-ifc14xx"

SDK_VENDOR = "-ifc14xxsdk"
SDK_NAME_PREFIX = "${DISTRO}"
SDK_VERSION = "${@'${DISTRO_VERSION}'.replace('snapshot-${DATE}','snapshot')}-${PREFERRED_VERSION_linux-qoriq_qoriq-ppc}"

POKY_DEFAULT_DISTRO_FEATURES_remove = " ptest"
DISTRO_FEATURES_append = " opengl pam virtualization"
DISTRO_FEATURES_remove = " gobject-introspection-data"

LICENSE_FLAGS_WHITELIST = "non-commercial_netperf"

MKUBIFS_ARGS = "-m 512 -e 15360 -c 12000"
UBINIZE_ARGS = "-m 512 -p 16KiB -s 512"

BOOT_TYPE ?= "nor"
BOOT_TYPE_ls1043a = "sd"
BOOT_TYPE_ls1046a = "sd"
BOOT_TYPE_ls1088a = "qspi"
BOOT_TYPE_ls2088a = "qspi"

PREFERRED_PROVIDER_qemu_qoriq = "qemu-qoriq"
PREFERRED_VERSION_linux-qoriq_qoriq-ppc = "4.9"
PREFERRED_VERSION_diffutils_qoriq-ppc = "3.3"
PREFERRED_VERSION_nativesdk-diffutils_qoriq-ppc = "3.3"

PREFERRED_PROVIDER_virtual/nativesdk-crypt_qoriq-ppc = "nativesdk-glibc"
PREFERRED_PROVIDER_virtual/nativesdk-crypt_qoriq-arm64 = "nativesdk-libxcrypt"
PREFERRED_PROVIDER_virtual/nativesdk-crypt_qoriq-arm = "nativesdk-libxcrypt"

GCCVERSION_qoriq-ppc = "4.9.2"
BINUVERSION_qoriq-ppc = "2.25"
GLIBCVERSION_qoriq-ppc = "2.20"
PREFERRED_VERSION_virtual/nativesdk-libiconv = "2.20"
TARGET_CC_KERNEL_ARCH_e6500 = " -m64"
TARGET_LD_KERNEL_ARCH_e6500 = " -melf64ppc"
```

## sources/meta-ioxos/conf/layer.conf
```bitbake
# We have a conf and classes directory, add to BBPATH
BBPATH .= ":${LAYERDIR}"

# We have recipes-* directories, add to BBFILES
BBFILES += "${LAYERDIR}/recipes-*/*/*.bb \
	${LAYERDIR}/recipes-*/*/*.bbappend"

BBFILE_COLLECTIONS += "ifc14xx"
BBFILE_PATTERN_ifc14xx = "^${LAYERDIR}/"
BBFILE_PRIORITY_ifc14xx = "6"

LAYERSERIES_COMPAT_ifc14xx = "sumo"
```

## sources/meta-ioxos/recipes-bsp/u-boot/u-boot-qoriq-2017.12/ifc14xx/Kconfig
```kconfig
if TARGET_IFC1410

config SYS_BOARD
	default "ifc14xx"

config SYS_VENDOR
	default "freescale"

config SYS_CONFIG_NAME
	default "ifc14xx"

endif
```

## sources/meta-ioxos/recipes-bsp/u-boot/u-boot-qoriq-2018.03/ifc14xx/Kconfig
```kconfig
if TARGET_IFC14XX

config SYS_BOARD
	default "ifc14xx"

config SYS_VENDOR
	default "freescale"

config SYS_CONFIG_NAME
	default "ifc14xx"

endif
```
